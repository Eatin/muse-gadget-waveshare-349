## esp32/components/muse/Kconfig
```kconfig
# Copyright (c) Meta Platforms, Inc. and affiliates.
#
# Licensed under the Apache License, Version 2.0 (the "License");
# you may not use this file except in compliance with the License.
# You may obtain a copy of the License at
#
#     http://www.apache.org/licenses/LICENSE-2.0
#
# Unless required by applicable law or agreed to in writing, software
# distributed under the License is distributed on an "AS IS" BASIS,
# WITHOUT WARRANTIES OR CONDITIONS OF ANY KIND, either express or implied.
# See the License for the specific language governing permissions and
# limitations under the License.

menu "Muse"

    choice MUSE_BOARD
        prompt "Board with the full UI"
        default MUSE_BOARD_NONE
        help
            The UI is the voice companion on boards with a screen: an
            animated avatar, push-to-talk chat, settings, and battery
            handling. It runs beside Home Link, which owns Wi-Fi, BLE
            pairing, credentials and OTA. Pick the board it runs on, or none
            for a Link without a display.

        config MUSE_BOARD_NONE
            bool "None (Home Link without a display)"

        config MUSE_BOARD_WAVESHARE_S3_175C
            bool "Waveshare ESP32-S3-Touch-AMOLED-1.75C"
            depends on IDF_TARGET_ESP32S3

        config MUSE_BOARD_WAVESHARE_S3_175
            bool "Waveshare ESP32-S3-Touch-AMOLED-1.75 (not the 1.75C)"
            depends on IDF_TARGET_ESP32S3

        config MUSE_BOARD_WAVESHARE_S3_216
            bool "Waveshare ESP32-S3-Touch-AMOLED-2.16"
            depends on IDF_TARGET_ESP32S3

        config MUSE_BOARD_AIPI
            bool "AIPI Lite (ESP32-S3, two buttons, no touch)"
            depends on IDF_TARGET_ESP32S3

        config MUSE_BOARD_ESPRESSIF_BOX_3
            bool "Espressif ESP32-S3-BOX-3 (320x240 touch LCD, speaker and microphones)"
            depends on IDF_TARGET_ESP32S3

        config MUSE_BOARD_WAVESHARE_C6_18
            bool "Waveshare ESP32-C6-Touch-AMOLED-1.8"
            depends on IDF_TARGET_ESP32C6

        config MUSE_BOARD_WAVESHARE_C6_206
            bool "Waveshare ESP32-C6-Touch-AMOLED-2.06"
            depends on IDF_TARGET_ESP32C6

        config MUSE_BOARD_SENSECAP_WATCHER
            bool "Seeed SenseCAP Watcher (ESP32-S3, round touch LCD, wheel)"
            depends on IDF_TARGET_ESP32S3

        config MUSE_BOARD_M5STACK_CARDPUTER_ADV
            bool "M5Stack Cardputer ADV (ESP32-S3, keyboard, no PSRAM)"
            depends on IDF_TARGET_ESP32S3

        config MUSE_BOARD_M5STACK_STICKS3
            bool "M5Stack StickS3 (ESP32-S3, two buttons, no touch)"
            depends on IDF_TARGET_ESP32S3

        config MUSE_BOARD_M5STACK_STICKC_PLUS2
            bool "M5Stack StickC Plus2 (ESP32, two buttons, no touch)"
            depends on IDF_TARGET_ESP32

        config MUSE_BOARD_M5STACK_STOPWATCH
            bool "M5Stack StopWatch (ESP32-S3, round touch AMOLED)"
            depends on IDF_TARGET_ESP32S3

        config MUSE_BOARD_M5STACK_CORES3
            bool "M5Stack CoreS3 (ESP32-S3, 320x240 touch LCD, speaker and microphones)"
            depends on IDF_TARGET_ESP32S3

        config MUSE_BOARD_M5STACK_CORE2
            bool "M5Stack Core2 v1.0 (ESP32, touch LCD, touch-strip talk)"
            depends on IDF_TARGET_ESP32
        config MUSE_BOARD_FNK0104B
            bool "Freenove FNK0104B (ESP32-S3, 240x320 touch LCD, ES8311 speaker and mic)"
            depends on IDF_TARGET_ESP32S3
        config MUSE_BOARD_GUITION_JC3248W535
            bool "Guition JC3248W535 (ESP32-S3, 3.5\" 320x480 touch LCD, speaker)"
            depends on IDF_TARGET_ESP32S3

        config MUSE_BOARD_WAVESHARE_S3_LCD_349
            bool "Waveshare ESP32-S3-Touch-LCD-3.49 V2 (172x640 touch LCD, ES8311 and ES7210)"
            depends on IDF_TARGET_ESP32S3

        config MUSE_BOARD_WAVESHARE_S3_LCD7
            bool "Waveshare ESP32-S3-Touch-LCD-7 (800x480 touch LCD, no audio)"
            depends on IDF_TARGET_ESP32S3
        config MUSE_BOARD_VN_S3_183
            bool "VN ESP32-S3 board (1.83\" 284x240 NV3023 LCD, ES8311 and ES7210)"
            depends on IDF_TARGET_ESP32S3
        config MUSE_BOARD_AI_PASSPORT
            bool "FoloToy AI Passport (ESP32-C3, three buttons, no touch)"
            depends on IDF_TARGET_ESP32C3
    endchoice

    config MUSE_ENABLED
        bool
        default y if !MUSE_BOARD_NONE

    # Always defined, unlike the target-dependent board options, so
    # idf_component.yml rules can select each board's managed components.
    config MUSE_BOARD_ID
        string
        default "waveshare_s3_175c" if MUSE_BOARD_WAVESHARE_S3_175C
        default "waveshare_s3_175" if MUSE_BOARD_WAVESHARE_S3_175
        default "waveshare_s3_216" if MUSE_BOARD_WAVESHARE_S3_216
        default "aipi" if MUSE_BOARD_AIPI
        default "espressif_box_3" if MUSE_BOARD_ESPRESSIF_BOX_3
        default "waveshare_c6_18" if MUSE_BOARD_WAVESHARE_C6_18
        default "waveshare_c6_206" if MUSE_BOARD_WAVESHARE_C6_206
        default "sensecap_watcher" if MUSE_BOARD_SENSECAP_WATCHER
        default "m5stack_sticks3" if MUSE_BOARD_M5STACK_STICKS3
        default "m5stack_stickc_plus2" if MUSE_BOARD_M5STACK_STICKC_PLUS2
        default "m5stack_cardputer_adv" if MUSE_BOARD_M5STACK_CARDPUTER_ADV
        default "m5stack_stopwatch" if MUSE_BOARD_M5STACK_STOPWATCH
        default "m5stack_cores3" if MUSE_BOARD_M5STACK_CORES3
        default "m5stack_core2" if MUSE_BOARD_M5STACK_CORE2
        default "fnk0104b" if MUSE_BOARD_FNK0104B
        default "guition_jc3248w535" if MUSE_BOARD_GUITION_JC3248W535
        default "waveshare_s3_lcd_349" if MUSE_BOARD_WAVESHARE_S3_LCD_349
        default "waveshare_s3_lcd7" if MUSE_BOARD_WAVESHARE_S3_LCD7
        default "vn_s3_183" if MUSE_BOARD_VN_S3_183
        default "ai_passport" if MUSE_BOARD_AI_PASSPORT
        default "none"

    # The Muse tools' serial port: the console UART behind the board's USB
    # bridge, where the chip's own USB Serial/JTAG isn't wired to a connector
    # (the Watcher's USB-C goes to a CH342) or the chip has none.
    config MUSE_CONSOLE_UART
        bool
        default y if MUSE_BOARD_SENSECAP_WATCHER || MUSE_BOARD_WAVESHARE_S3_LCD7 || !SOC_USB_SERIAL_JTAG_SUPPORTED

    # A board overlay can raise this for a quiet speaker.
    config MUSE_DEFAULT_VOLUME
        int "Speaker volume until one is chosen in settings (percent)"
        range 0 100
        default 70

    config MUSE_WATCHER_CAMERA
        bool "SenseCAP Watcher camera capture and live preview"
        depends on MUSE_BOARD_SENSECAP_WATCHER && SPIRAM
        default n
        help
            Enable the camera.capture Home Link command and the wheel
            double-click camera preview. Camera buffers and tasks consume
            memory and preview decoding shares CPU time with voice and Link.
            Leave disabled to build without camera support.

    config MUSE_CJK_FONT
        bool "Show Chinese and Japanese in captions"
        depends on MUSE_ENABLED
        default n
        help
            Captions fall back to GNU Unifont's 16x16 bitmaps for CJK
            punctuation, kana, the CJK Unified Ideographs and fullwidth
            forms that the ASCII caption font lacks. Small screens, whose
            captions are two lines of 8 px text, show a reply with CJK in it
            one 16 px line at a time. Takes about 850 KB of flash and no RAM.
            Without it those characters show as boxes. Hangul isn't
            included.

    config MUSE_JC3248W535_MIC_GPIO
        int "JC3248W535: GPIO for an external I2S mic's data (SD) line"
        depends on MUSE_BOARD_GUITION_JC3248W535
        range -1 48
        default -1
        help
            The board has a speaker amp but no microphone. Wire an I2S MEMS
            mic such as an INMP441 to the speaker's clocks (SCK to GPIO42, WS
            to GPIO2), L/R to GND, power to 3.3 V, and its SD line to a free
            GPIO, and set that GPIO here. -1 leaves push-to-talk recording
            silence.

    config MUSE_HATCH
        bool "Muse's own voice session"
        depends on MUSE_ENABLED && !MUSE_CN_VOICE
        default y if SPIRAM
        default n
        help
            Push-to-talk turns go over a voice session of Muse's own, to the
            VM Home Link is paired with or one set up on the device with a
            device token. Replies are text, shown as captions; start_tts in
            muse_chat_session.cpp is where a TTS API of your own can speak
            them. Needs PSRAM. Without it, voice notes go over Home Link's own
            session to its paired VM and replies are shown as text.

    config MUSE_CN_VOICE
        bool "Chinese voice assistant (iFlytek ASR + SenseNova LLM)"
        depends on MUSE_ENABLED
        default n
        help
            Backs the same muse_chat.h API as MUSE_HATCH, but talks straight to
            讯飞 for speech recognition and 商汤 SenseNova for the answer, and
            讯飞 again to speak it back. No Meta account and no device token:
            the push-to-talk state machine, the buttons and the captions are
            unchanged, only the far end is.

            One turn is: press -> 16 kHz PCM into PSRAM -> iFlytek ASR over a
            WebSocket -> SenseNova over HTTPS -> caption, then iFlytek TTS
            (raw 16 kHz PCM) out of the speaker. Long answers are paged across
            the caption band at reading pace. All four credentials below are
            empty by default; see README.waveshare-s3-lcd-349.md.

    if MUSE_CN_VOICE

    config MUSE_CN_XFYUN_HOST
        string "iFlytek ASR WebSocket host"
        default "iat.cn-huabei-1.xf-yun.com"

    config MUSE_CN_XFYUN_APPID
        string "iFlytek APPID"
        default ""

    config MUSE_CN_XFYUN_APIKEY
        string "iFlytek APIKey"
        default ""

    config MUSE_CN_XFYUN_APISECRET
        string "iFlytek APISecret"
        default ""

    config MUSE_CN_XFYUN_LANGUAGE
        string "iFlytek language"
        default "zh_cn"
        help
            Must match the product the APPID is licensed for, or the first
            frame comes back `11201 licc failed` even though the handshake
            succeeds and the account looks fine.

            zh_cn       语音听写大模型（中英）V2.0 / 中英识别大模型 -- pair it
                        with MUSE_CN_XFYUN_DOMAIN below.
            mul_cn      大模型多语种语音识别 (32 languages, auto-detect).

            Measured 2026-10-10: the 多语种 subscription lapsed and every turn
            failed with 11201 until this was switched from mul_cn to zh_cn.

    config MUSE_CN_XFYUN_DOMAIN
        string "iFlytek domain"
        default "spark_asr_v2"
        help
            parameter.iat.domain.  Fixed per product, not a free choice:

            spark_asr_v2  语音听写大模型（中英）V2.0
            slm           中英识别大模型（中文+202 方言免切）

            Both answer code=0 on iat.cn-huabei-1.xf-yun.com when licensed, so
            this only decides which product's quota is drawn down.

    config MUSE_CN_SENSENOVA_URL
        string "SenseNova chat completions URL"
        default "https://token.sensenova.cn/v1/chat/completions"

    config MUSE_CN_SENSENOVA_KEY
        string "SenseNova API key"
        default ""

    config MUSE_CN_SENSENOVA_MODEL
        string "SenseNova model"
        default "deepseek-v4-flash"

    config MUSE_CN_AUTOTEST
        bool "Run a voice turn by itself shortly after boot (debug)"
        default n
        help
            Debug aid.  A few seconds after the network comes up, run one text
            turn and one synthetic audio turn, logging every stage.  Lets a
            build be verified from the serial log alone, with nobody holding
            the button -- and, since a crash inside a turn wipes the log and
            the ROM reset banner, it also reports the previous reset reason
            after the USB console is back.

            It stops for good after three boots, so an autotest that resets
            the chip cannot loop forever.

    endif # MUSE_CN_VOICE

endmenu
```
